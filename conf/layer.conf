## conf/layer.conf
```bitbake
# We have a conf and classes directory, add to BBPATH
BBPATH .= ":${LAYERDIR}"

# We have recipes-* directories, add to BBFILES
BBFILES += "${LAYERDIR}/recipes-*/*/*.bb \
            ${LAYERDIR}/recipes-*/*/*.bbappend"

BBFILE_COLLECTIONS += "meta-rpi-gpu"
BBFILE_PATTERN_meta-rpi-gpu = "^${LAYERDIR}/"
BBFILE_PRIORITY_meta-rpi-gpu = "6"

LAYERDEPENDS_meta-rpi-gpu = "core"
LAYERSERIES_COMPAT_meta-rpi-gpu = "scarthgap"
```
